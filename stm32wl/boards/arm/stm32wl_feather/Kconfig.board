## stm32wl/boards/arm/stm32wl_feather/Kconfig.board
```kconfig
# STM32WL55CC Feather board configuration

# Copyright (c) 2021 PureEngineering, LLC

config BOARD_STM32WL_FEATHER
	bool "STM32WL55CC Feather Development Board"
	depends on SOC_STM32WL55XX
```

## stm32wl/boards/arm/stm32wl_feather/Kconfig.defconfig
```kconfig
# STM32WL55CC Feather board configuration

# Copyright (c) 2021 PureEngineering, LLC

if BOARD_STM32WL_FEATHER

config BOARD
	default "stm32wl_feather"

endif # BOARD_STM32WL_FEATHER
```
